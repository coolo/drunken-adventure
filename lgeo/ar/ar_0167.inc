/*******************************************************************************/
/*                                                                             */
/* LGEO Libray Include File     (C) lgeo@digitalbricks.org (Lutz Uhlmann)      */
/*                                                                             */
/* 20080512 Lutz Uhlmann created shortcut to original part by Anton Raves      */
/* 20080717 Lutz Uhlmann added missing semicolon                               */
/*                                                                             */
/* This file is in no way related to the LEGO(tm) Group.                       */
/* It is provided for private non-commercial use only.                         */
/*                                                                             */
/* ar_0167: Bar 1 x 3                                                          */
/*                                                                             */ 
/*******************************************************************************/
#ifdef(ar_0167)
#else
#include "ar_material.inc"
#include "ar_library.inc"
#include "ar_6190.inc"
#declare setting = 2;
#declare ar_0167 =
object {
 ar_6190
}

#declare ar_3001_clear =
object {
 ar_6190
}
#end
